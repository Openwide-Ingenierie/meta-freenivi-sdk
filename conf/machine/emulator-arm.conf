## conf/machine/emulator-arm.conf
```bitbake
#@TYPE: Machine
#@NAME: emulator-arm
#@DESCRIPTION: Machine configuration for running in arm (versatile_926ejs) emulator

require conf/machine/include/qemu.inc
require conf/machine/include/tune-arm926ejs.inc
require conf/machine/include/emulator.inc

PREFERRED_VERSION_linux-yocto = "3.19%"

KERNEL_IMAGETYPE = "zImage"

SERIAL_CONSOLE = "115200 ttyAMA0"
```

## conf/machine/emulator-corei7.conf
```bitbake
#@TYPE: Machine
#@NAME: emulator-corei7
#@DESCRIPTION: Machine configuration for running in intel emulator

require conf/machine/include/qemu.inc
require conf/machine/include/tune-corei7.inc
require conf/machine/include/emulator.inc

KERNEL_IMAGETYPE = "bzImage"

SERIAL_CONSOLE = "115200 ttyAMA0"
```

## conf/machine/emulator-x86.conf
```bitbake
#@TYPE: Machine
#@NAME: emulator-x86 
#@DESCRIPTION: Machine configuration for running in x86 emulator

PREFERRED_PROVIDER_virtual/xserver ?= "xserver-xorg"

require conf/machine/include/qemu.inc
require conf/machine/include/tune-i586.inc
require conf/machine/include/emulator.inc

KERNEL_IMAGETYPE = "bzImage"

SERIAL_CONSOLE = "115200 ttyS0"

MACHINE_FEATURES += "x86"
```

## conf/machine/include/emulator.inc
```bitbake
PREFERRED_PROVIDER_virtual/libgl = "yagl"
PREFERRED_PROVIDER_virtual/libgles1 = "yagl"
PREFERRED_PROVIDER_virtual/libgles2 = "yagl"
PREFERRED_PROVIDER_virtual/egl = "yagl"
PREFERRED_PROVIDER_virtual/mesa = "yagl"
PREFERRED_PROVIDER_virtual/wayland-egl = "yagl"

PREFERRED_PROVIDER_virtual/kernel = "linux-yocto"
PREFERRED_VERSION_linux-yocto = "3.14%"

XSERVER = " \
    xserver-xorg \
    ${@bb.utils.contains('DISTRO_FEATURES', 'opengl', 'mesa-driver-swrast', '', d)} \
    xf86-input-vmmouse \
    xf86-input-keyboard \
    xf86-input-evdev \
    xf86-video-cirrus \
    xf86-video-fbdev \
    xf86-video-vmware \
"

MACHINEOVERRIDES =. "emulator:"
```
